## Documentation/devicetree/bindings/depends-on.txt
```
Functional dependency linking
=============================

Apart from parent-child relationships, devices (consumers) often have
functional dependencies on other devices (suppliers). Common examples of
suppliers are clock, regulators, pinctrl, etc. However not all of them are
dependencies with well defined devicetree bindings. Also, not all functional
dependencies are mandatory as the device might be able to operate in a limited
mode without some of the dependencies.

The depends-on property allows marking these mandatory functional dependencies
between one or more devices. The depends-on property is used by the consumer
device to point to all its mandatory supplier devices.

Optional properties:
- depends-on:	A list of phandles to mandatory suppliers of the device.


Examples:
Here, the device is dependent on only 2 of the 3 clock providers
dev@40031000 {
	      compatible = "name";
	      reg = <0x40031000 0x1000>;
	      clocks = <&osc_1 1>, <&osc_2 7> <&osc_3 5>;
	      depends-on = <&osc_1>, <&osc_3>;
};
```

## Documentation/devicetree/bindings/mailbox/arm-smc.txt
```
ARM SMC Mailbox Interface
=========================

This mailbox uses the ARM smc (secure monitor call) instruction to trigger
a mailbox-connected activity in firmware, executing on the very same core
as the caller. By nature this operation is synchronous and this mailbox
provides no way for asynchronous messages to be delivered the other way
round, from firmware to the OS, but asynchronous notification could also
be supported. However the value of r0/w0/x0 the firmware returns after
the smc call is delivered as a received message to the mailbox framework,
so a synchronous communication can be established, for a asynchronous
notification, no value will be returned. The exact meaning of both the
action the mailbox triggers as well as the return value is defined by
their users and is not subject to this binding.

One use case of this mailbox is the SCMI interface, which uses shared memory
to transfer commands and parameters, and a mailbox to trigger a function
call. This allows SoCs without a separate management processor (or when
such a processor is not available or used) to use this standardized
interface anyway.

This binding describes no hardware, but establishes a firmware interface.
Upon receiving an SMC using one of the described SMC function identifiers,
the firmware is expected to trigger some mailbox connected functionality.
The communication follows the ARM SMC calling convention[1].
Firmware expects an SMC function identifier in r0 or w0. The supported
identifiers are passed from consumers, or listed in the the arm,func-ids
properties as described below. The firmware can return one value in
the first SMC result register, it is expected to be an error value,
which shall be propagated to the mailbox client.

Any core which supports the SMC or HVC instruction can be used, as long as
a firmware component running in EL3 or EL2 is handling these calls.

Mailbox Device Node:
====================

This node is expected to be a child of the /firmware node.

Required properties:
--------------------
- compatible:		Shall be "arm,smc-mbox"
- #mbox-cells		Shall be 1 - the index of the channel needed.
- arm,num-chans		The number of channels supported.
- method:		A string, either:
			"hvc": if the driver shall use an HVC call, or
			"smc": if the driver shall use an SMC call.

Optional properties:
- arm,func-ids		An array of 32-bit values specifying the function
			IDs used by each mailbox channel. Those function IDs
			follow the ARM SMC calling convention standard [1].
			There is one identifier per channel and the number
			of supported channels is determined by the length
			of this array.
- interrupts		SPI interrupts may be listed for notification,
			each channel should use a dedicated interrupt
			line.

Example:
--------

	sram@910000 {
		compatible = "mmio-sram";
		reg = <0x0 0x93f000 0x0 0x1000>;
		#address-cells = <1>;
		#size-cells = <1>;
		ranges = <0 0x0 0x93f000 0x1000>;

		cpu_scp_lpri: scp-shmem@0 {
			compatible = "arm,scmi-shmem";
			reg = <0x0 0x200>;
		};

		cpu_scp_hpri: scp-shmem@200 {
			compatible = "arm,scmi-shmem";
			reg = <0x200 0x200>;
		};
	};

	smc_mbox: mailbox {
		#mbox-cells = <1>;
		compatible = "arm,smc-mbox";
		method = "smc";
		arm,num-chans = <0x2>;
		/* Optional */
		arm,func-ids = <0xc20000fe>, <0xc20000ff>;
	};

	firmware {
		scmi {
			compatible = "arm,scmi";
			mboxes = <&mailbox 0 &mailbox 1>;
			mbox-names = "tx", "rx";
			shmem = <&cpu_scp_lpri &cpu_scp_hpri>;
		};
	};


[1]
http://infocenter.arm.com/help/index.jsp?topic=/com.arm.doc.den0028a/index.html
```

## drivers/smaf/Kconfig
```kconfig
config SMAF
	tristate "Secure Memory Allocation Framework"
	depends on DMA_SHARED_BUFFER
	help
	  Choose this option to enable Secure Memory Allocation Framework

config SMAF_CMA
	tristate "SMAF CMA allocator"
	depends on SMAF
	help
	  Choose this option to enable CMA allocation within SMAF

config SMAF_TEST_SECURE
	tristate "SMAF secure module for test"
	depends on SMAF
	help
	  Choose this option to enable secure module for test purpose

config SMAF_OPTEE_ALLOCATOR
	tristate "SMAF OPTEE Allocator"
	depends on SMAF && TEE && OPTEE
	help
	  Choose this option to enable Secure allocation from OP-TEE within SMAF

config SMAF_OPTEE
	tristate "SMAF OPTEE interface"
	depends on SMAF && TEE && OPTEE
	help
	  Choose this option to enable secure module from OP-TEE within SMAF

config SMAF_RUNTIME_MEMORY
	boolean "TEE can be invoked to reconfigure memory protection means"
	depends on SMAF && TEE
	default y
	help
	  You should enable this if the system support memory areas that are
	  use as pools for both secure and non-secure memory. SMAF will invoke
	  TEE to setup protection means of memory areas (create region) or
	  release protection means (destroy region) as secure buffers a
	  requested and released.

config SMAF_RUNTIME_DEVICE
	boolean "TEE can be invoked to modify a device operating secure state"
	depends on SMAF && TEE
	default y
	help
	  You should enable this if the system support devices that have a
	  reconfigurable operating secure state. SMAF will invoke TEE to
	  reconfigure target device access permissions (at some HW secure
	  level) accoring to system needs.
```
